## config/west.yml
```yaml
manifest:
  defaults:
    revision: v0.3
  remotes:
    - name: zmkfirmware
      url-base: https://github.com/zmkfirmware
    # Additional modules containing boards/shields/custom code can be listed here as well
    # See https://docs.zephyrproject.org/3.2.0/develop/west/manifest.html#projects
    - name: urob
      url-base: https://github.com/urob
  #additional modules
    - name: petejohanson
      url-base: https://github.com/petejohanson
    - name: gpeye
      url-base: https://github.com/GPeye
    - name: mctechnology17
      url-base: https://github.com/mctechnology17
    - name: kevinpastor
      url-base: https://github.com/kevinpastor
    - name: m165437
      url-base: https://github.com/M165437
    - name: s6t
      url-base: https://github.com/s6t
    - name: infely
      url-base: https://github.com/infely
    - name: penguinchat
      url-base: https://github.com/penguinchat
    - name: englmaxi
      url-base: https://github.com/englmaxi


  projects:
    - name: zmk
      remote: urob
      import: app/west.yml
      revision: v0.3
      import: app/west.yml
    - name: zmk-helpers
      remote: urob
      revision: v0.3

    #additional module
    - name: hammerbeam-slideshow
      remote: gpeye
      revision: main
    - name: zmk-nice-oled
      remote: mctechnology17
      revision: main
    - name: nice-view-elemental
      remote: kevinpastor
      revision: main
    - name: nice-view-gem
      remote: m165437
      revision: main
    - name: zmk-shield-nice-view-cats
      remote: s6t
      revision: main
    - name: nice-view-battery
      remote: infely
      revision: main
    - name: zmk-dongle-screen
      remote: penguinchat
      revision: Penguinchat-patch-1
    - name: zmk-for-PandaKB.com-
      remote: penguinchat
      revision: PandaKB_Lily58
    - name: zmk-dongle-display
      remote: englmaxi
      revision: v0.3

  self:
    path: config
```
